## conf/layer.conf
```bitbake
# We have a conf and classes directory, append to BBPATH
BBPATH .= ":${LAYERDIR}"

# We have a recipes directory, add to BBFILES
BBFILES += "${LAYERDIR}/recipes*/*/*.bb ${LAYERDIR}/recipes*/*/*.bbappend"

BBFILE_COLLECTIONS += "meta-cubox"
BBFILE_PATTERN_meta-cubox := "^${LAYERDIR}/"
BBFILE_PRIORITY_meta-cubox = "10"
```

## conf/machine/cubox.conf
```bitbake
#@TYPE: Machine
#@NAME: Cubox
#@DESCRIPTION: Machine configuration for the Solid Box Cubox

DEFAULTTUNE="armv7a"

require conf/machine/include/arm/arch-armv7a.inc

UBOOT_MACHINE = "cubox_config"
UBOOT_ENTRYPOINT = "0xc0008000"
UBOOT_LOADADDRESS = "0xc0008000"

MACHINE_FEATURES = "kernel26 serial ethernet"

SERIAL_CONSOLE = "115200 ttyS2"

PREFERRED_PROVIDER_virtual/kernel = "linux-cubox"
PREFERRED_PROVIDER_virtual/bootloader = "u-boot"
```
